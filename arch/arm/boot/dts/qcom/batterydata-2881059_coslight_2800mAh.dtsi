
qcom,2881059_coslight_2800mAh {
	/* #2881059_coslight_2800mAh*/
	qcom,max-voltage-uv = <4400000>;
	qcom,nom-batt-capacity-mah = <2800>;
	qcom,batt-id-kohm = <20>;
	qcom,battery-beta = <4050>;
	qcom,battery-type = "2881059_coslight_2800mAh";
	qcom,chg-rslow-comp-c1 = <3194882>;
	qcom,chg-rslow-comp-c2 = <5100761>;
	qcom,chg-rs-to-rslow = <509036>;
	qcom,chg-rslow-comp-thr = <0xAF>;
	qcom,fastchg-current-ma = <2000>;
	qcom,fg-cc-cv-threshold-mv = <4390>;
	qcom,checksum = <0x709C>;
	qcom,gui-version = "PMI8950GUI - 2.0.0.16";
	qcom,fg-profile-data = [
		 DE 83 AA 7C 
		 EB 80 E4 76 
		 5D 83 18 6D 
		 56 88 5A 8F 
		 61 82 D0 93 
		 2D B5 9B C0 
		 52 16 ED 83 
		 B9 7C C8 80 
		 5B 76 58 83 
		 BB 61 15 81 
		 AB 8D 4C 82 
		 AA 99 EB BC 
		 C7 C9 54 0E 
		 39 0B 3F 61 
		 14 70 71 FD 
		 45 3E CC 3E 
		 3F 39 00 00 
		 90 46 C4 3A 
		 CE 34 00 00 
		 00 00 00 00 
		 00 00 00 00 
		 B7 68 FF 63 
		 3A 71 47 8A 
		 31 76 6A 6A 
		 DF 61 88 82 
		 2F 75 18 69 
		 F6 52 37 A9 
		 1B 80 5A 6A 
		 5C A0 71 0C 
		 28 00 FF 36 
		 F0 11 30 03 
		 00 00 00 0C 
	];
};
