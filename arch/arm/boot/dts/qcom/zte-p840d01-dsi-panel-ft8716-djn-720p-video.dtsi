/* Copyright (c) 2015-2016, The Linux Foundation. All rights reserved.
 *
 * This program is free software; you can redistribute it and/or modify
 * it under the terms of the GNU General Public License version 2 and
 * only version 2 as published by the Free Software Foundation.
 *
 * This program is distributed in the hope that it will be useful,
 * but WITHOUT ANY WARRANTY; without even the implied warranty of
 * MERCHANTABILITY or FITNESS FOR A PARTICULAR PURPOSE.  See the
 * GNU General Public License for more details.
 */

&mdss_mdp {
	dsi_ft8716_djn_720p_video: qcom,mdss_dsi_ft8716_djn_720p_video {
		qcom,mdss-dsi-panel-name = "ft8716 djn 720p video mode dsi panel";
		zte,lcd-proc-panel-name ="zteDJN(ft8716)_720*1280-5.0Inch";
		//zte,panel-reset-early-enabled;
		zte,power-off-remove-to-tp;
		qcom,cont-splash-enabled;
		qcom,mdss-dsi-panel-controller = <&mdss_dsi0>;
		qcom,mdss-dsi-panel-type = "dsi_video_mode";
		qcom,panel-supply-entries = <&dsi_panel_pwr_supply>;
		qcom,mdss-dsi-panel-destination = "display_1";
		qcom,mdss-dsi-panel-framerate = <60>;
		qcom,mdss-dsi-virtual-channel-id = <0>;
		qcom,mdss-dsi-stream = <0>;
		qcom,mdss-dsi-panel-width = <720>;
		qcom,mdss-dsi-panel-height = <1280>;
		qcom,mdss-dsi-h-front-porch = <78>;
		qcom,mdss-dsi-h-back-porch = <6>;
		qcom,mdss-dsi-h-pulse-width = <4>;
		qcom,mdss-dsi-h-sync-skew = <0>;
		qcom,mdss-dsi-v-front-porch = <100>;
		qcom,mdss-dsi-v-back-porch = <100>;
		qcom,mdss-dsi-v-pulse-width = <100>;
		qcom,mdss-dsi-h-left-border = <0>;
		qcom,mdss-dsi-h-right-border = <0>;
		qcom,mdss-dsi-v-top-border = <0>;
		qcom,mdss-dsi-v-bottom-border = <0>;
		qcom,mdss-dsi-bpp = <24>;
		qcom,mdss-dsi-underflow-color = <0xff>;
		qcom,mdss-dsi-border-color = <0>;

		qcom,mdss-dsi-on-command = [05 01 00 00 78 00 02 11 00 
39 01 00 00 00 00 03 50 5a 09 
39 01 00 00 00 00 11 90 00 00 42 0a e3 25 9b f0 c3 d7 66 20 19 a1 26 00 	
39 01 00 00 00 00 03 50 5a 0e
39 01 00 00 00 00 04 83 ac b4 6d
39 01 00 00 00 00 03 50 5a 19
39 01 00 00 00 00 04 8d 85 ff cf
39 01 00 00 00 00 08 90 fc 6f f6 7f cf af 0f
39 01 00 00 00 00 03 a1 04 02
39 01 00 00 00 00 02 a2 40 //dimming setting
39 01 00 00 00 00 03 50 5a 23
39 01 00 00 00 00 03 90 00 00
39 01 00 00 00 00 02 94 24
39 01 00 00 00 00 02 95 01
39 01 00 00 00 00 03 50 5a 2f 
39 01 00 00 00 00 02 09 01 
05 01 00 00 14 00 02 29 00
		];
		qcom,mdss-dsi-off-command = [
			05 01 00 00 14 00 02 28 00
			05 01 00 00 78 00 02 10 00
		];
		qcom,mdss-dsi-on-command-state = "dsi_lp_mode";
		qcom,mdss-dsi-off-command-state = "dsi_hs_mode";
		qcom,mdss-dsi-lp11-init;
		qcom,mdss-dsi-h-sync-pulse = <0>;
		qcom,mdss-dsi-traffic-mode = "burst_mode";
		qcom,mdss-dsi-bllp-eof-power-mode;
		qcom,mdss-dsi-bllp-power-mode;
		qcom,mdss-dsi-lane-0-state;
		qcom,mdss-dsi-lane-1-state;
		qcom,mdss-dsi-lane-2-state;
		qcom,mdss-dsi-lane-3-state;
		qcom,mdss-dsi-panel-timings = [87 1C 12 00 42 44 18 20 17 03 04 00];
		qcom,mdss-dsi-t-clk-post = <0x04>;
		qcom,mdss-dsi-t-clk-pre = <0x1B>;
		qcom,mdss-dsi-bl-min-level = <1>;
		qcom,mdss-dsi-bl-max-level = <4095>;
		qcom,mdss-dsi-dma-trigger = "trigger_sw";
		qcom,mdss-dsi-mdp-trigger = "none";
		qcom,mdss-dsi-bl-pmic-control-type = "bl_ctrl_dcs_wled";
		qcom,mdss-dsi-reset-sequence = <0 2>, <0 2>, <1 40>;
		qcom,mdss-pan-physical-width-dimension = <62>;
		qcom,mdss-pan-physical-height-dimension = <110>;

	};
};
